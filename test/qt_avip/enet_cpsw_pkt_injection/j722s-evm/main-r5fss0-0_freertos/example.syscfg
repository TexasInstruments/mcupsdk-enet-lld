/**
 * @cliArgs --device "J722S_TDA4VEN_TDA4AEN_AM67" --package "AMW" --part "Default" --context "main-r5fss0-0" --product "MCU_PLUS_SDK@07.03.01"
 * @versions {"tool":"1.20.0+3587"}
 */

/**
 * Import the modules used in this configuration.
 */
const ethphy_cpsw_icssg  = scripting.addModule("/board/ethphy_cpsw_icssg/ethphy_cpsw_icssg", {}, false);
const ethphy_cpsw_icssg1 = ethphy_cpsw_icssg.addInstance();
const ethphy_cpsw_icssg2 = ethphy_cpsw_icssg.addInstance();
const i2c                = scripting.addModule("/drivers/i2c/i2c", {}, false);
const i2c1               = i2c.addInstance();
const debug_log          = scripting.addModule("/kernel/dpl/debug_log");
const mpu_armv7          = scripting.addModule("/kernel/dpl/mpu_armv7", {}, false);
const mpu_armv71         = mpu_armv7.addInstance();
const mpu_armv72         = mpu_armv7.addInstance();
const enet_cpsw          = scripting.addModule("/networking/enet_cpsw/enet_cpsw", {}, false);
const enet_cpsw1         = enet_cpsw.addInstance();

/**
 * Write custom configuration values to the imported modules.
 */
i2c1.$name = "CONFIG_I2C0";

debug_log.enableUartLog                      = true;
debug_log.uartLog.$name                      = "CONFIG_UART0";
debug_log.uartLog.useWakeupDomainPeripherals = false;
debug_log.uartLog.UART.$assign               = "USART0";

mpu_armv71.size              = 31;
mpu_armv71.attributes        = "Device";
mpu_armv71.accessPermissions = "Supervisor RD+WR, User RD";
mpu_armv71.allowExecute      = false;
mpu_armv71.$name             = "CONFIG_MPU_REGISTER";

mpu_armv72.$name = "CONFIG_MPU_MCU_MSRAM";
mpu_armv72.size  = 23;

enet_cpsw1.$name                 = "CONFIG_ENET_CPSW0";
enet_cpsw1.macAddrConfig         = "Manual Entry";
enet_cpsw1.macport1LoopbackMode  = "LOOPBACK_MODE_PHY";
enet_cpsw1.macport1LinkSpeed     = "ENET_SPEED_1GBIT";
enet_cpsw1.macport1LinkDuplexity = "ENET_DUPLEX_FULL";
enet_cpsw1.macport2LoopbackMode  = "LOOPBACK_MODE_PHY";
enet_cpsw1.macport2LinkSpeed     = "ENET_SPEED_1GBIT";
enet_cpsw1.macport2LinkDuplexity = "ENET_DUPLEX_FULL";
enet_cpsw1.RGMII1.$assign        = "RGMII1";
enet_cpsw1.txDmaChannel[0].$name = "ENET_DMA_TX_CH0";
enet_cpsw1.rxDmaChannel[0].$name = "ENET_DMA_RX_CH0";

ethphy_cpsw_icssg1.$name      = "CONFIG_ENET_ETHPHY0";
ethphy_cpsw_icssg1.peripheral = "CPSW_MAC_PORT_1";
enet_cpsw1.ethphy1            = ethphy_cpsw_icssg1;
ethphy_cpsw_icssg1.phyAddr    = -1;

ethphy_cpsw_icssg2.$name   = "CONFIG_ENET_ETHPHY1";
ethphy_cpsw_icssg2.peripheral = "CPSW_MAC_PORT_2";
enet_cpsw1.ethphy2         = ethphy_cpsw_icssg2;
ethphy_cpsw_icssg2.phyAddr = -1;

const udma               = scripting.addModule("/drivers/udma/udma", {}, false);
const udma1              = udma.addInstance({}, false);
udma1.skipGlobalEventReg = true;
enet_cpsw1.udmaDrv       = udma1;

/**
 * Pinmux solution for unlocked pins/peripherals. This ensures that minor changes to the automatic solver in a future
 * version of the tool will not impact the pinmux you originally saw.  These lines can be completely deleted in order to
 * re-solve from scratch.
 */
i2c1.WKUP_I2C.$suggestSolution              = "WKUP_I2C0";
i2c1.WKUP_I2C.SCL.$suggestSolution          = "WKUP_I2C0_SCL";
i2c1.WKUP_I2C.SDA.$suggestSolution          = "WKUP_I2C0_SDA";
debug_log.uartLog.UART.RXD.$suggestSolution = "UART0_RXD";
debug_log.uartLog.UART.TXD.$suggestSolution = "UART0_TXD";
enet_cpsw1.MDIO.$suggestSolution            = "MDIO0";
enet_cpsw1.MDIO.MDC.$suggestSolution        = "MDIO0_MDC";
enet_cpsw1.MDIO.MDIO.$suggestSolution       = "MDIO0_MDIO";
enet_cpsw1.RGMII1.RD0.$suggestSolution      = "RGMII1_RD0";
enet_cpsw1.RGMII1.RD1.$suggestSolution      = "RGMII1_RD1";
enet_cpsw1.RGMII1.RD2.$suggestSolution      = "RGMII1_RD2";
enet_cpsw1.RGMII1.RD3.$suggestSolution      = "RGMII1_RD3";
enet_cpsw1.RGMII1.RX_CTL.$suggestSolution   = "RGMII1_RX_CTL";
enet_cpsw1.RGMII1.RXC.$suggestSolution      = "RGMII1_RXC";
enet_cpsw1.RGMII1.TD0.$suggestSolution      = "RGMII1_TD0";
enet_cpsw1.RGMII1.TD1.$suggestSolution      = "RGMII1_TD1";
enet_cpsw1.RGMII1.TD2.$suggestSolution      = "RGMII1_TD2";
enet_cpsw1.RGMII1.TD3.$suggestSolution      = "RGMII1_TD3";
enet_cpsw1.RGMII1.TX_CTL.$suggestSolution   = "RGMII1_TX_CTL";
enet_cpsw1.RGMII1.TXC.$suggestSolution      = "RGMII1_TXC";
enet_cpsw1.RGMII2.$suggestSolution          = "RGMII2";
enet_cpsw1.RGMII2.RD0.$suggestSolution      = "VOUT0_HSYNC";
enet_cpsw1.RGMII2.RD1.$suggestSolution      = "VOUT0_DE";
enet_cpsw1.RGMII2.RD2.$suggestSolution      = "VOUT0_VSYNC";
enet_cpsw1.RGMII2.RD3.$suggestSolution      = "VOUT0_PCLK";
enet_cpsw1.RGMII2.RX_CTL.$suggestSolution   = "VOUT0_DATA14";
enet_cpsw1.RGMII2.RXC.$suggestSolution      = "VOUT0_DATA15";
enet_cpsw1.RGMII2.TD0.$suggestSolution      = "VOUT0_DATA10";
enet_cpsw1.RGMII2.TD1.$suggestSolution      = "VOUT0_DATA11";
enet_cpsw1.RGMII2.TD2.$suggestSolution      = "VOUT0_DATA12";
enet_cpsw1.RGMII2.TD3.$suggestSolution      = "VOUT0_DATA13";
enet_cpsw1.RGMII2.TX_CTL.$suggestSolution   = "VOUT0_DATA8";
enet_cpsw1.RGMII2.TXC.$suggestSolution      = "VOUT0_DATA9";
