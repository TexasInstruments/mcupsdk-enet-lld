/**
 * @cliArgs --device "TDA54" --part "Default" --package "AMW" --context "mcu0" --product "MCU_PLUS_SDK@07.03.01"
 * @versions {"tool":"1.21.0+3721"}
 */

/**
 * Import the modules used in this configuration.
 */
const ethphy_cpsw_icssg  = scripting.addModule("/board/ethphy_cpsw_icssg/ethphy_cpsw_icssg", {}, false);
const ethphy_cpsw_icssg1 = ethphy_cpsw_icssg.addInstance();
const udma               = scripting.addModule("/drivers/udma/udma", {}, false);
const udma1              = udma.addInstance();
const debug_log          = scripting.addModule("/kernel/dpl/debug_log");
const enet_cpsw          = scripting.addModule("/networking/enet_cpsw/enet_cpsw", {}, false);
const enet_cpsw1         = enet_cpsw.addInstance();

/**
 * Write custom configuration values to the imported modules.
 */
ethphy_cpsw_icssg1.$name      = "CONFIG_ENET_ETHPHY0";
ethphy_cpsw_icssg1.peripheral = "CPSW_MAC_PORT_1";
ethphy_cpsw_icssg1.phySelect  = "NO-PHY";
scripting.suppress("Warning : Ethphy device is not linked to a network peripheral", ethphy_cpsw_icssg1);

debug_log.enableLogZoneWarning   = false;
debug_log.enableLogZoneError     = false;
debug_log.enableUartLog          = true;
debug_log.uartLog.$name          = "CONFIG_UART0";
debug_log.uartLog.intrEnable     = "DISABLE";
debug_log.uartLog.UART.$assign   = "USART0";
debug_log.uartLog.UART.RXD.rx    = false;
debug_log.uartLog.UART.RXD.$used = false;
debug_log.uartLog.UART.TXD.$used = false;

enet_cpsw1.$name                        = "CONFIG_ENET_CPSW0";
enet_cpsw1.macAddrConfig                = "Manual Entry";
enet_cpsw1.customBoardEnable            = true;
enet_cpsw1.hostpostPassCrcErrors        = true;
enet_cpsw1.macport1LinkSpeed            = "ENET_SPEED_1GBIT";
enet_cpsw1.macport1LinkDuplexity        = "ENET_DUPLEX_FULL";
enet_cpsw1.macport2LinkSpeed            = "ENET_SPEED_1GBIT";
enet_cpsw1.macport2LinkDuplexity        = "ENET_DUPLEX_FULL";
enet_cpsw1.macport3LinkSpeed            = "ENET_SPEED_1GBIT";
enet_cpsw1.macport3LinkDuplexity        = "ENET_DUPLEX_FULL";
enet_cpsw1.macport4LinkSpeed            = "ENET_SPEED_1GBIT";
enet_cpsw1.macport4LinkDuplexity        = "ENET_DUPLEX_FULL";
enet_cpsw1.macport5LinkSpeed            = "ENET_SPEED_1GBIT";
enet_cpsw1.macport5LinkDuplexity        = "ENET_DUPLEX_FULL";
enet_cpsw1.macport6LinkSpeed            = "ENET_SPEED_1GBIT";
enet_cpsw1.macport6LinkDuplexity        = "ENET_DUPLEX_FULL";
enet_cpsw1.macport7LinkSpeed            = "ENET_SPEED_1GBIT";
enet_cpsw1.macport7LinkDuplexity        = "ENET_DUPLEX_FULL";
enet_cpsw1.macport8LinkSpeed            = "ENET_SPEED_1GBIT";
enet_cpsw1.macport8LinkDuplexity        = "ENET_DUPLEX_FULL";
enet_cpsw1.RGMII1.$assign               = "RGMII1";
enet_cpsw1.txDmaChannel[0].$name        = "ENET_DMA_TX_CH0";
enet_cpsw1.txDmaChannel[0].PacketsCount = 4;
enet_cpsw1.rxDmaChannel[0].$name        = "ENET_DMA_RX_CH0";

enet_cpsw1.udmaDrv       = udma1;
udma1.skipGlobalEventReg = true;

/**
 * Pinmux solution for unlocked pins/peripherals. This ensures that minor changes to the automatic solver in a future
 * version of the tool will not impact the pinmux you originally saw.  These lines can be completely deleted in order to
 * re-solve from scratch.
 */
enet_cpsw1.MDIO.$suggestSolution          = "MDIO0";
enet_cpsw1.MDIO.MDC.$suggestSolution      = "MDIO0_MDC";
enet_cpsw1.MDIO.MDIO.$suggestSolution     = "MDIO0_MDIO";
enet_cpsw1.RGMII1.RD0.$suggestSolution    = "RGMII1_RD0";
enet_cpsw1.RGMII1.RD1.$suggestSolution    = "RGMII1_RD1";
enet_cpsw1.RGMII1.RD2.$suggestSolution    = "RGMII1_RD2";
enet_cpsw1.RGMII1.RD3.$suggestSolution    = "RGMII1_RD3";
enet_cpsw1.RGMII1.RX_CTL.$suggestSolution = "RGMII1_RX_CTL";
enet_cpsw1.RGMII1.RXC.$suggestSolution    = "RGMII1_RXC";
enet_cpsw1.RGMII1.TD0.$suggestSolution    = "RGMII1_TD0";
enet_cpsw1.RGMII1.TD1.$suggestSolution    = "RGMII1_TD1";
enet_cpsw1.RGMII1.TD2.$suggestSolution    = "RGMII1_TD2";
enet_cpsw1.RGMII1.TD3.$suggestSolution    = "RGMII1_TD3";
enet_cpsw1.RGMII1.TX_CTL.$suggestSolution = "RGMII1_TX_CTL";
enet_cpsw1.RGMII1.TXC.$suggestSolution    = "RGMII1_TXC";
enet_cpsw1.RGMII2.$suggestSolution        = "RGMII2";
enet_cpsw1.RGMII2.RD0.$suggestSolution    = "VOUT0_HSYNC";
enet_cpsw1.RGMII2.RD1.$suggestSolution    = "VOUT0_DE";
enet_cpsw1.RGMII2.RD2.$suggestSolution    = "VOUT0_VSYNC";
enet_cpsw1.RGMII2.RD3.$suggestSolution    = "VOUT0_PCLK";
enet_cpsw1.RGMII2.RX_CTL.$suggestSolution = "VOUT0_DATA14";
enet_cpsw1.RGMII2.RXC.$suggestSolution    = "VOUT0_DATA15";
enet_cpsw1.RGMII2.TD0.$suggestSolution    = "VOUT0_DATA10";
enet_cpsw1.RGMII2.TD1.$suggestSolution    = "VOUT0_DATA11";
enet_cpsw1.RGMII2.TD2.$suggestSolution    = "VOUT0_DATA12";
enet_cpsw1.RGMII2.TD3.$suggestSolution    = "VOUT0_DATA13";
enet_cpsw1.RGMII2.TX_CTL.$suggestSolution = "VOUT0_DATA8";
enet_cpsw1.RGMII2.TXC.$suggestSolution    = "VOUT0_DATA9";
