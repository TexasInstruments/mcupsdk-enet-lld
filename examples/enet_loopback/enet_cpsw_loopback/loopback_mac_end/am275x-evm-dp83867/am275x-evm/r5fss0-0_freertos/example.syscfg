/**
 * @cliArgs --device "AM275x" --part "AM2754" --package "ANJ" --context "r5fss0-0" --product "MCU_PLUS_SDK@07.03.01"
 * @versions {"tool":"1.21.0+3721"}
 */

/**
 * Import the modules used in this configuration.
 */
const eeprom     = scripting.addModule("/board/eeprom/eeprom", {}, false);
const eeprom1    = eeprom.addInstance();
const i2c        = scripting.addModule("/drivers/i2c/i2c", {}, false);
const i2c1       = i2c.addInstance();
const clock      = scripting.addModule("/kernel/dpl/clock");
const debug_log  = scripting.addModule("/kernel/dpl/debug_log");
const mpu_armv7  = scripting.addModule("/kernel/dpl/mpu_armv7", {}, false);
const mpu_armv71 = mpu_armv7.addInstance();
const mpu_armv72 = mpu_armv7.addInstance();
const mpu_armv73 = mpu_armv7.addInstance();
const mpu_armv74 = mpu_armv7.addInstance();
const mpu_armv75 = mpu_armv7.addInstance();
const enet_cpsw  = scripting.addModule("/networking/enet_cpsw/enet_cpsw", {}, false);
const enet_cpsw1 = enet_cpsw.addInstance();

/**
 * Write custom configuration values to the imported modules.
 */
eeprom1.$name = "CONFIG_EEPROM0";

i2c1.$name               = "CONFIG_I2C0";
eeprom1.peripheralDriver = i2c1;
i2c1.I2C.$assign         = "I2C0";
i2c1.I2C_child.$name     = "drivers_i2c_v0_i2c_v0_template0";

debug_log.enableLogZoneInfo        = true;
debug_log.enableUartLog            = true;
debug_log.enableCssLog             = false;
debug_log.uartLog.$name            = "CONFIG_UART0";
debug_log.uartLog.intrEnable       = "DISABLE";
debug_log.uartLog.UART.$assign     = "UART0";
debug_log.uartLog.UART.RXD.$assign = "UART0_RXD";
debug_log.uartLog.UART.TXD.$assign = "UART0_TXD";

mpu_armv71.size              = 31;
mpu_armv71.attributes        = "Device";
mpu_armv71.accessPermissions = "Supervisor RD+WR, User RD";
mpu_armv71.allowExecute      = false;
mpu_armv71.$name             = "REGISTERS";

mpu_armv72.size              = 15;
mpu_armv72.accessPermissions = "Supervisor RD+WR, User RD";
mpu_armv72.$name             = "TCMA";

mpu_armv73.baseAddr          = 0x41010000;
mpu_armv73.size              = 15;
mpu_armv73.accessPermissions = "Supervisor RD+WR, User RD";
mpu_armv73.$name             = "TCMB";

mpu_armv74.$name    = "MSRAM_BANK0_TO_BANK3";
mpu_armv74.baseAddr = 0x72000000;
mpu_armv74.size     = 22;

mpu_armv75.$name    = "MSRAM_BANK4_TO_BANK5";
mpu_armv75.baseAddr = 0x72400000;
mpu_armv75.size     = 21;

enet_cpsw1.$name                 = "CONFIG_ENET_CPSW0";
enet_cpsw1.DisableMacPort2       = true;
enet_cpsw1.macport1LoopbackMode  = "LOOPBACK_MODE_MAC";
enet_cpsw1.txDmaChannel[0].$name = "ENET_DMA_TX_CH0";
enet_cpsw1.rxDmaChannel[0].$name = "ENET_DMA_RX_CH0";

const udma         = scripting.addModule("/drivers/udma/udma", {}, false);
const udma1        = udma.addInstance({}, false);
enet_cpsw1.udmaDrv = udma1;

/**
 * Pinmux solution for unlocked pins/peripherals. This ensures that minor changes to the automatic solver in a future
 * version of the tool will not impact the pinmux you originally saw.  These lines can be completely deleted in order to
 * re-solve from scratch.
 */
i2c1.I2C.SCL.$suggestSolution             = "I2C0_SCL";
i2c1.I2C.SDA.$suggestSolution             = "I2C0_SDA";
enet_cpsw1.MDIO.$suggestSolution          = "MDIO0";
enet_cpsw1.MDIO.MDC.$suggestSolution      = "MDIO0_MDC";
enet_cpsw1.MDIO.MDIO.$suggestSolution     = "MDIO0_MDIO";
enet_cpsw1.RGMII1.$suggestSolution        = "RGMII2";
enet_cpsw1.RGMII1.RD0.$suggestSolution    = "RGMII2_RD0";
enet_cpsw1.RGMII1.RD1.$suggestSolution    = "RGMII2_RD1";
enet_cpsw1.RGMII1.RD2.$suggestSolution    = "RGMII2_RD2";
enet_cpsw1.RGMII1.RD3.$suggestSolution    = "RGMII2_RD3";
enet_cpsw1.RGMII1.RX_CTL.$suggestSolution = "RGMII2_RX_CTL";
enet_cpsw1.RGMII1.RXC.$suggestSolution    = "RGMII2_RXC";
enet_cpsw1.RGMII1.TD0.$suggestSolution    = "RGMII2_TD0";
enet_cpsw1.RGMII1.TD1.$suggestSolution    = "RGMII2_TD1";
enet_cpsw1.RGMII1.TD2.$suggestSolution    = "RGMII2_TD2";
enet_cpsw1.RGMII1.TD3.$suggestSolution    = "RGMII2_TD3";
enet_cpsw1.RGMII1.TX_CTL.$suggestSolution = "RGMII2_TX_CTL";
enet_cpsw1.RGMII1.TXC.$suggestSolution    = "RGMII2_TXC";
enet_cpsw1.RGMII2.$suggestSolution        = "RGMII1";
enet_cpsw1.RGMII2.RD0.$suggestSolution    = "RGMII1_RD0";
enet_cpsw1.RGMII2.RD1.$suggestSolution    = "RGMII1_RD1";
enet_cpsw1.RGMII2.RD2.$suggestSolution    = "RGMII1_RD2";
enet_cpsw1.RGMII2.RD3.$suggestSolution    = "RGMII1_RD3";
enet_cpsw1.RGMII2.RX_CTL.$suggestSolution = "RGMII1_RX_CTL";
enet_cpsw1.RGMII2.RXC.$suggestSolution    = "RGMII1_RXC";
enet_cpsw1.RGMII2.TD0.$suggestSolution    = "RGMII1_TD0";
enet_cpsw1.RGMII2.TD1.$suggestSolution    = "RGMII1_TD1";
enet_cpsw1.RGMII2.TD2.$suggestSolution    = "RGMII1_TD2";
enet_cpsw1.RGMII2.TD3.$suggestSolution    = "RGMII1_TD3";
enet_cpsw1.RGMII2.TX_CTL.$suggestSolution = "RGMII1_TX_CTL";
enet_cpsw1.RGMII2.TXC.$suggestSolution    = "RGMII1_TXC";
