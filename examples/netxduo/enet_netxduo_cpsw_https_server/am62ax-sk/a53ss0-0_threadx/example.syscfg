/**
 * @cliArgs --device "AM62Ax" --part "Default" --package "AMB" --context "a53ss0-0" --product "MCU_PLUS_SDK@07.03.01"
 * @versions {"tool":"1.21.2+3837"}
 */

/**
 * Import the modules used in this configuration.
 */
const eeprom     = scripting.addModule("/board/eeprom/eeprom", {}, false);
const eeprom1    = eeprom.addInstance();
const i2c        = scripting.addModule("/drivers/i2c/i2c", {}, false);
const i2c1       = i2c.addInstance();
const debug_log  = scripting.addModule("/kernel/dpl/debug_log");
const mmu_armv8  = scripting.addModule("/kernel/dpl/mmu_armv8", {}, false);
const mmu_armv81 = mmu_armv8.addInstance();
const mmu_armv82 = mmu_armv8.addInstance();
const mmu_armv83 = mmu_armv8.addInstance();
const mmu_armv84 = mmu_armv8.addInstance();
const enet_cpsw  = scripting.addModule("/networking/enet_cpsw/enet_cpsw", {}, false);
const enet_cpsw1 = enet_cpsw.addInstance();
const netxduo    = scripting.addModule("/networking/netxduo/netxduo", {}, false);
const netxduo1   = netxduo.addInstance();

/**
 * Write custom configuration values to the imported modules.
 */
eeprom1.$name = "CONFIG_EEPROM0";

i2c1.$name               = "CONFIG_I2C0";
eeprom1.peripheralDriver = i2c1;
i2c1.I2C.$assign         = "I2C0";
i2c1.I2C.SCL.$assign     = "I2C0_SCL";
i2c1.I2C.SDA.$assign     = "I2C0_SDA";
i2c1.I2C_child.$name     = "drivers_i2c_v0_i2c_v0_template1";

debug_log.enableUartLog        = true;
debug_log.enableCssLog         = true;
debug_log.uartLog.$name        = "CONFIG_UART_CONSOLE";
debug_log.uartLog.UART.$assign = "USART0";

mmu_armv81.size  = 0x80000000;
mmu_armv81.$name = "SOC_MEM_REGION";

mmu_armv82.vAddr     = 0x70000000;
mmu_armv82.pAddr     = 0x70000000;
mmu_armv82.size      = 0x200000;
mmu_armv82.$name     = "SHM_MEM_REGION";
mmu_armv82.attribute = "MAIR7";

mmu_armv83.vAddr     = 0x80000000;
mmu_armv83.pAddr     = 0x80000000;
mmu_armv83.size      = 0x80000000;
mmu_armv83.$name     = "DDR_REGION";
mmu_armv83.attribute = "MAIR7";

mmu_armv84.$name     = "DMA_REGION";
mmu_armv84.attribute = "MAIR4";
mmu_armv84.vAddr     = 0x81FC0000;
mmu_armv84.pAddr     = 0x81FC0000;
mmu_armv84.size      = 0x40000;

enet_cpsw1.$name                          = "CONFIG_ENET_CPSW0";
enet_cpsw1.macAddrConfig                  = "Manual Entry";
enet_cpsw1.LargePoolPktCount              = 80;
enet_cpsw1.PktPoolEnable                  = false;
enet_cpsw1.PktInfoOnlyEnable              = true;
enet_cpsw1.PktInfoOnlyCount               = 128;
enet_cpsw1.txDmaChannel[0].$name          = "ENET_DMA_TX_CH0";
enet_cpsw1.txDmaChannel[0].PacketsCount   = 32;
enet_cpsw1.rxDmaChannel.create(2);
enet_cpsw1.rxDmaChannel[0].$name          = "ENET_DMA_RX_CH0";
enet_cpsw1.rxDmaChannel[1].$name          = "ENET_DMA_RX_CH1";
enet_cpsw1.rxDmaChannel[1].useDefaultFlow = false;

const ethphy_cpsw_icssg  = scripting.addModule("/board/ethphy_cpsw_icssg/ethphy_cpsw_icssg", {}, false);
const ethphy_cpsw_icssg1 = ethphy_cpsw_icssg.addInstance({}, false);
ethphy_cpsw_icssg1.$name = "CONFIG_ENET_ETHPHY0";
enet_cpsw1.ethphy1       = ethphy_cpsw_icssg1;

const ethphy_cpsw_icssg2 = ethphy_cpsw_icssg.addInstance({}, false);
ethphy_cpsw_icssg2.$name = "CONFIG_ENET_ETHPHY1";
enet_cpsw1.ethphy2       = ethphy_cpsw_icssg2;

const udma         = scripting.addModule("/drivers/udma/udma", {}, false);
const udma1        = udma.addInstance({}, false);
enet_cpsw1.udmaDrv = udma1;

netxduo1.$name                           = "CONFIG_NETXDUO0";
netxduo1.netxduoIfInstance.create(1);
netxduo1.netxduoIfInstance[0].$name      = "CONFIG_NETX_IF0";
netxduo1.netxduoIfInstance[0].isDefault  = true;
netxduo1.netxduoIfInstance[0].rxDmaChNum = ["0","1"];

/**
 * Pinmux solution for unlocked pins/peripherals. This ensures that minor changes to the automatic solver in a future
 * version of the tool will not impact the pinmux you originally saw.  These lines can be completely deleted in order to
 * re-solve from scratch.
 */
debug_log.uartLog.UART.RXD.$suggestSolution = "UART0_RXD";
debug_log.uartLog.UART.TXD.$suggestSolution = "UART0_TXD";
enet_cpsw1.MDIO.$suggestSolution            = "MDIO0";
enet_cpsw1.MDIO.MDC.$suggestSolution        = "MDIO0_MDC";
enet_cpsw1.MDIO.MDIO.$suggestSolution       = "MDIO0_MDIO";
enet_cpsw1.RGMII1.$suggestSolution          = "RGMII2";
enet_cpsw1.RGMII1.RD0.$suggestSolution      = "RGMII2_RD0";
enet_cpsw1.RGMII1.RD1.$suggestSolution      = "RGMII2_RD1";
enet_cpsw1.RGMII1.RD2.$suggestSolution      = "RGMII2_RD2";
enet_cpsw1.RGMII1.RD3.$suggestSolution      = "RGMII2_RD3";
enet_cpsw1.RGMII1.RX_CTL.$suggestSolution   = "RGMII2_RX_CTL";
enet_cpsw1.RGMII1.RXC.$suggestSolution      = "RGMII2_RXC";
enet_cpsw1.RGMII1.TD0.$suggestSolution      = "RGMII2_TD0";
enet_cpsw1.RGMII1.TD1.$suggestSolution      = "RGMII2_TD1";
enet_cpsw1.RGMII1.TD2.$suggestSolution      = "RGMII2_TD2";
enet_cpsw1.RGMII1.TD3.$suggestSolution      = "RGMII2_TD3";
enet_cpsw1.RGMII1.TX_CTL.$suggestSolution   = "RGMII2_TX_CTL";
enet_cpsw1.RGMII1.TXC.$suggestSolution      = "RGMII2_TXC";
enet_cpsw1.RGMII2.$suggestSolution          = "RGMII1";
enet_cpsw1.RGMII2.RD0.$suggestSolution      = "RGMII1_RD0";
enet_cpsw1.RGMII2.RD1.$suggestSolution      = "RGMII1_RD1";
enet_cpsw1.RGMII2.RD2.$suggestSolution      = "RGMII1_RD2";
enet_cpsw1.RGMII2.RD3.$suggestSolution      = "RGMII1_RD3";
enet_cpsw1.RGMII2.RX_CTL.$suggestSolution   = "RGMII1_RX_CTL";
enet_cpsw1.RGMII2.RXC.$suggestSolution      = "RGMII1_RXC";
enet_cpsw1.RGMII2.TD0.$suggestSolution      = "RGMII1_TD0";
enet_cpsw1.RGMII2.TD1.$suggestSolution      = "RGMII1_TD1";
enet_cpsw1.RGMII2.TD2.$suggestSolution      = "RGMII1_TD2";
enet_cpsw1.RGMII2.TD3.$suggestSolution      = "RGMII1_TD3";
enet_cpsw1.RGMII2.TX_CTL.$suggestSolution   = "RGMII1_TX_CTL";
enet_cpsw1.RGMII2.TXC.$suggestSolution      = "RGMII1_TXC";
