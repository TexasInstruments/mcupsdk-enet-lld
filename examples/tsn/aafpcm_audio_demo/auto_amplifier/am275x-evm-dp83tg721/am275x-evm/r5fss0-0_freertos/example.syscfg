/**
 * @cliArgs --device "AM275x" --part "AM2754" --package "ANJ" --context "r5fss0-0" --product "MCU_PLUS_SDK@07.03.01"
 * @versions {"tool":"1.24.2+4234"}
 */

/**
 * Import the modules used in this configuration.
 */
const eeprom             = scripting.addModule("/board/eeprom/eeprom", {}, false);
const eeprom1            = eeprom.addInstance();
const eeprom2            = eeprom.addInstance();
const eeprom3            = eeprom.addInstance();
const ethphy_cpsw_icssg  = scripting.addModule("/board/ethphy_cpsw_icssg/ethphy_cpsw_icssg", {}, false);
const ethphy_cpsw_icssg1 = ethphy_cpsw_icssg.addInstance();
const gpio               = scripting.addModule("/drivers/gpio/gpio", {}, false);
const gpio1              = gpio.addInstance();
const gpio2              = gpio.addInstance();
const gpio3              = gpio.addInstance();
const gpio4              = gpio.addInstance();
const gpio5              = gpio.addInstance();
const i2c                = scripting.addModule("/drivers/i2c/i2c", {}, false);
const i2c1               = i2c.addInstance();
const mcasp              = scripting.addModule("/drivers/mcasp/mcasp");
const mcasp1             = mcasp.addInstance();
const mcasp2             = mcasp.addInstance();
const clock              = scripting.addModule("/kernel/dpl/clock");
const debug_log          = scripting.addModule("/kernel/dpl/debug_log");
const mpu_armv7          = scripting.addModule("/kernel/dpl/mpu_armv7", {}, false);
const mpu_armv71         = mpu_armv7.addInstance();
const mpu_armv72         = mpu_armv7.addInstance();
const mpu_armv73         = mpu_armv7.addInstance();
const mpu_armv74         = mpu_armv7.addInstance();
const mpu_armv75         = mpu_armv7.addInstance();
const mpu_armv76         = mpu_armv7.addInstance();
const timer              = scripting.addModule("/kernel/dpl/timer", {}, false);
const timer1             = timer.addInstance();
const timer2             = timer.addInstance();
const enet_cpsw          = scripting.addModule("/networking/enet_cpsw/enet_cpsw", {}, false);
const enet_cpsw1         = enet_cpsw.addInstance();

/**
 * Write custom configuration values to the imported modules.
 */
eeprom1.$name = "CONFIG_EEPROM0";

eeprom2.$name      = "RGMII1_EEPROM";
eeprom2.i2cAddress = 0x57;

eeprom3.$name      = "RGMII2_EEPROM";
eeprom3.i2cAddress = 0x56;

gpio1.$name        = "AUDIO_TX_GPIO";
gpio1.pinDir       = "OUTPUT";
gpio1.GPIO.$assign = "GPIO1_49";

gpio2.$name        = "CONFIG_GPIO_TX_MCASP";
gpio2.pinDir       = "OUTPUT";
gpio2.GPIO.$assign = "MCASP4_ACLKX";

gpio3.$name        = "CONFIG_GPIO_LISTENER";
gpio3.pinDir       = "OUTPUT";
gpio3.GPIO.$assign = "MCASP0_AXR10";

gpio4.$name        = "CONFIG_GPIO_TALKER";
gpio4.pinDir       = "OUTPUT";
gpio4.GPIO.$assign = "MLB0_MLBSIG";

gpio5.$name        = "CONFIG_GPIO_RX_MCASP";
gpio5.pinDir       = "OUTPUT";
gpio5.GPIO.$assign = "MCASP0_AXR11";

i2c1.$name               = "CONFIG_I2C0";
eeprom1.peripheralDriver = i2c1;
eeprom2.peripheralDriver = i2c1;
eeprom3.peripheralDriver = i2c1;
i2c1.I2C.$assign         = "I2C0";
i2c1.I2C_child.$name     = "drivers_i2c_v0_i2c_v0_template0";

mcasp["TISCI_DEV_MCASP<n>_AUXCLK_SEL_DEV_VD_CLK_PARENT_BOARD_0_AUDIO_EXT_REFCLK2_OUT"] = "24576000";

mcasp1.$name                                   = "CONFIG_MCASP0";
mcasp1.enableLoopback                          = false;
mcasp1.skipDriverOpen                          = true;
mcasp1.txDataMask                              = 0xFFFFFFFF;
mcasp1.rxDataMask                              = 0xFFFFFFFF;
mcasp1.TxMode                                  = "TDM";
mcasp1.NumTxSlots                              = 8;
mcasp1.txActiveSlotMask                        = 0xFF;
mcasp1.RxMode                                  = "TDM";
mcasp1.NumRxSlots                              = 8;
mcasp1.rxActiveSlotMask                        = 0xFF;
mcasp1.rxFsWidth                               = 0;
mcasp1.rxFsPolarity                            = 0;
mcasp1.rxBitClkPolarity                        = 0;
mcasp1.txFsPolarity                            = 0;
mcasp1.txHclkSource                            = 0;
mcasp1.rxHclkSource                            = 0;
mcasp1.rxHclkSourceMux                         = 4;
mcasp1.txHclkSourceMux                         = 4;
mcasp1.clkSyncMode                             = "ASYNC";
mcasp1.txLoopjobBufLength                      = 512;
mcasp1.rxLoopjobBufLength                      = 512;
mcasp1.txCallbackFxn                           = "AutoAmp_playbackMcaspTxCb";
mcasp1.rxCallbackFxn                           = "AutoAmp_playbackMcaspRxCb";
mcasp1.txHclkDiv                               = 1;
mcasp1.txBclkCalculated                        = 12288000;
mcasp1.mcasp_auxclk_gf_sel                     = "1";
mcasp1.aux_clk_sel                             = "5";
mcasp1.rxHclkDiv                               = 1;
mcasp1.rxBclkCalculated                        = 12288000;
mcasp1.txClkDiv                                = 2;
mcasp1.txHclkExpected                          = 24576000;
mcasp1.txClkApplyAlert                         = false;
mcasp1.rxClkDiv                                = 2;
mcasp1.rxHclkExpected                          = 24576000;
mcasp1.rxClkApplyAlert                         = false;
mcasp1.MCASP.$assignAllowConflicts             = "MCASP1";
mcasp1.MCASP.ACLKX.pu_pd                       = "pu";
mcasp1.mcaspSer.create(2);
mcasp1.mcaspSer[0].$name                       = "CONFIG_MCASP_SER0";
mcasp1.mcaspSer[0].dataDir                     = "Receive";
mcasp1.mcaspSer[0].MCASP.$assignAllowConflicts = "MCASP1";
mcasp1.mcaspSer[1].$name                       = "CONFIG_MCASP_SER1";
mcasp1.mcaspSer[1].serNum                      = 1;
mcasp1.mcaspSer[1].MCASP.$assignAllowConflicts = "MCASP1";
mcasp1.CLOCKING.$assignAllowConflicts          = "CLOCKING";
scripting.suppress("Resource conflict,MCASP1 is also in use by @@@.+?@@@, @@@.+?@@@", mcasp1.MCASP, "$assign");
scripting.suppress("Resource conflict,MCASP1 is also in use by @@@.+?@@@, @@@.+?@@@", mcasp1.mcaspSer[0].MCASP, "$assign");
scripting.suppress("Resource conflict,MCASP1 is also in use by @@@.+?@@@, @@@.+?@@@", mcasp1.mcaspSer[1].MCASP, "$assign");
scripting.suppress("Resource conflict,CLOCKING is also in use by @@@.+?@@@", mcasp1.CLOCKING, "$assign");

mcasp2.enableLoopback                          = false;
mcasp2.skipDriverOpen                          = true;
mcasp2.enableMcaspRx                           = false;
mcasp2.txActiveSlotMask                        = 0x3;
mcasp2.txDataMask                              = 0xFFFFFFFF;
mcasp2.afsx                                    = 0;
mcasp2.txLoopjobBuf                            = "gTxLoopjobBuf1";
mcasp2.masterClkx                              = 1024;
mcasp2.fsx                                     = 0.3;
mcasp2.txClkDiv                                = 32;
mcasp2.txHclkCalculated                        = 614400;
mcasp2.txBclkCalculated                        = 19200;
mcasp2.txFsyncCalculated                       = 300;
mcasp2.rxClkDiv                                = 32;
mcasp2.rxHclkCalculated                        = 614400;
mcasp2.rxBclkCalculated                        = 19200;
mcasp2.rxFsyncCalculated                       = 300;
mcasp2.mcasp_auxclk_gf_sel                     = "1";
mcasp2.aux_clk_sel                             = "5";
mcasp2.txHclkDiv                               = 40;
mcasp2.rxHclkDiv                               = 40;
mcasp2.txClkApplyAlert                         = false;
mcasp2.rxClkApplyAlert                         = false;
mcasp2.txCallbackFxn                           = "EnetApp_TxMcaspTxCb";
mcasp2.$name                                   = "CONFIG_TS_MCASP";
mcasp2.CLOCKING.$assignAllowConflicts          = "CLOCKING";
mcasp2.mcaspSer.create(1);
mcasp2.mcaspSer[0].$name                       = "CONFIG_MCASP_SER2";
mcasp2.mcaspSer[0].MCASP.$assignAllowConflicts = "MCASP4";
mcasp2.MCASP.$assignAllowConflicts             = "MCASP4";
mcasp2.MCASP.AFSX.$assignAllowConflicts        = "MCASP4_AFSX";
mcasp2.MCASP.ACLKX.$used                       = false;
scripting.suppress("Resource conflict,CLOCKING is also in use by @@@.+?@@@", mcasp2.CLOCKING, "$assign");
scripting.suppress("Resource conflict,MCASP4 is also in use by @@@.+?@@@", mcasp2.mcaspSer[0].MCASP, "$assign");
scripting.suppress("Resource conflict,MCASP4 is also in use by @@@.+?@@@", mcasp2.MCASP, "$assign");

const udma         = scripting.addModule("/drivers/udma/udma", {}, false);
const udma1        = udma.addInstance({}, false);
udma1.$name        = "CONFIG_UDMA0";
mcasp1.bcDmaDriver = udma1;
mcasp2.bcDmaDriver = udma1;

debug_log.enableLogZoneInfo        = true;
debug_log.enableCssLog             = false;
debug_log.enableUartLog            = true;
debug_log.uartLog.$name            = "CONFIG_UART0";
debug_log.uartLog.UART.RXD.$assign = "UART0_RXD";
debug_log.uartLog.UART.TXD.$assign = "UART0_TXD";

mpu_armv71.size         = 31;
mpu_armv71.attributes   = "Device";
mpu_armv71.allowExecute = false;
mpu_armv71.$name        = "REGISTERS";

mpu_armv72.size              = 15;
mpu_armv72.accessPermissions = "Supervisor RD+WR, User RD";
mpu_armv72.$name             = "TCMA";

mpu_armv73.baseAddr          = 0x41010000;
mpu_armv73.size              = 15;
mpu_armv73.accessPermissions = "Supervisor RD+WR, User RD";
mpu_armv73.$name             = "TCMB";

mpu_armv74.$name    = "MSRAM_BANK0_TO_BANK3";
mpu_armv74.baseAddr = 0x72000000;
mpu_armv74.size     = 22;

mpu_armv75.$name    = "MSRAM_BANK4_TO_BANK5";
mpu_armv75.baseAddr = 0x72400000;
mpu_armv75.size     = 21;

mpu_armv76.$name        = "MCASP1";
mpu_armv76.baseAddr     = 0x2B10000;
mpu_armv76.size         = 13;
mpu_armv76.attributes   = "Device";
mpu_armv76.allowExecute = false;

timer1.$name         = "CONFIG_TIMER0";
timer1.timerCallback = "avbTickTimer_callback";
timer1.usecPerTick   = 124;

timer2.$name         = "CONFIG_CRF_TIMER";
timer2.usecPerTick   = 3333.3;
timer2.timerCallback = "CrfHwConfig_crfTsCb";

enet_cpsw1.$name                          = "CONFIG_ENET_CPSW0";
enet_cpsw1.macOnlyEn_hostPort             = true;
enet_cpsw1.macOnlyEn_macPort1             = true;
enet_cpsw1.macOnlyEn_macPort2             = true;
enet_cpsw1.mdioPollEnMask                 = [];
enet_cpsw1.hostportRxMtu                  = 1522;
enet_cpsw1.macport1RxMtu                  = 1522;
enet_cpsw1.macport2RxMtu                  = 1522;
enet_cpsw1.mdioMode                       = "MDIO_MODE_MANUAL";
enet_cpsw1.macAddrList                    = "70:ff:76:1d:e7:f2,70:ff:76:1d:e8:e3";
enet_cpsw1.TimestampSource                = "LLDTSYNC_TS_SOURCE_PHY";
enet_cpsw1.cptsHostRxTsEn                 = false;
enet_cpsw1.DisableMacPort2                = true;
enet_cpsw1.txDmaChannel.create(3);
enet_cpsw1.txDmaChannel[0].$name          = "ENET_DMA_TX_CH0";
enet_cpsw1.txDmaChannel[0].PacketsCount   = 4;
enet_cpsw1.txDmaChannel[1].$name          = "ENET_DMA_TX_CH_PTP";
enet_cpsw1.txDmaChannel[1].PacketsCount   = 4;
enet_cpsw1.txDmaChannel[2].$name          = "ENET_DMA_TX_CH_AVTP";
enet_cpsw1.rxDmaChannel.create(3);
enet_cpsw1.rxDmaChannel[0].$name          = "ENET_DMA_RX_CH0";
enet_cpsw1.rxDmaChannel[0].PacketsCount   = 8;
enet_cpsw1.rxDmaChannel[0].useGlobalEvt   = true;
enet_cpsw1.rxDmaChannel[1].$name          = "ENET_DMA_RX_CH_PTP";
enet_cpsw1.rxDmaChannel[1].macAddrCount   = 0;
enet_cpsw1.rxDmaChannel[1].PacketsCount   = 8;
enet_cpsw1.rxDmaChannel[1].useGlobalEvt   = true;
enet_cpsw1.rxDmaChannel[1].useDefaultFlow = false;
enet_cpsw1.rxDmaChannel[2].$name          = "ENET_DMA_RX_CH_AVTP";
enet_cpsw1.rxDmaChannel[2].macAddrCount   = 0;
enet_cpsw1.rxDmaChannel[2].PacketsCount   = 8;
enet_cpsw1.rxDmaChannel[2].useGlobalEvt   = true;
enet_cpsw1.rxDmaChannel[2].useDefaultFlow = false;

ethphy_cpsw_icssg1.$name          = "CONFIG_ENET_ETHPHY0";
enet_cpsw1.ethphy1                = ethphy_cpsw_icssg1;
ethphy_cpsw_icssg1.phySelect      = "DP83TG721";
ethphy_cpsw_icssg1.extendedConfig = ".isMDIMaster = false,\n.enablePTPstatusFrames = true,\n.srcMacStatusFrameType = 0,\n.clockSource = 1,\n.enableCodecClock = 1,\n.enableMediaClock = 0,\n.codecClkDiv = 10,";

const udma2        = udma.addInstance({}, false);
enet_cpsw1.udmaDrv = udma2;

/**
 * Pinmux solution for unlocked pins/peripherals. This ensures that minor changes to the automatic solver in a future
 * version of the tool will not impact the pinmux you originally saw.  These lines can be completely deleted in order to
 * re-solve from scratch.
 */
i2c1.I2C.SCL.$suggestSolution                      = "I2C0_SCL";
i2c1.I2C.SDA.$suggestSolution                      = "I2C0_SDA";
mcasp1.MCASP.AFSX.$suggestSolution                 = "MCASP1_AFSX";
mcasp1.MCASP.ACLKX.$suggestSolution                = "MCASP1_ACLKX";
mcasp1.MCASP.AFSR.$suggestSolution                 = "MCASP0_AXR15";
mcasp1.MCASP.ACLKR.$suggestSolution                = "MCASP0_AXR14";
mcasp1.mcaspSer[0].MCASP.AXR0.$suggestSolution     = "MCASP1_AXR0";
mcasp1.mcaspSer[1].MCASP.AXR1.$suggestSolution     = "MCASP1_AXR1";
mcasp1.CLOCKING.AUDIO_EXT_REFCLK2.$suggestSolution = "GPIO1_72";
mcasp2.mcaspSer[0].MCASP.AXR0.$suggestSolution     = "MCASP4_AXR0";
debug_log.uartLog.UART.$suggestSolution            = "UART0";
timer1.TIMER.$suggestSolution                      = "TIMER7";
timer2.TIMER.$suggestSolution                      = "TIMER6";
enet_cpsw1.MDIO.$suggestSolution                   = "MDIO0";
enet_cpsw1.MDIO.MDC.$suggestSolution               = "MDIO0_MDC";
enet_cpsw1.MDIO.MDIO.$suggestSolution              = "MDIO0_MDIO";
enet_cpsw1.RGMII1.$suggestSolution                 = "RGMII2";
enet_cpsw1.RGMII1.RD0.$suggestSolution             = "RGMII2_RD0";
enet_cpsw1.RGMII1.RD1.$suggestSolution             = "RGMII2_RD1";
enet_cpsw1.RGMII1.RD2.$suggestSolution             = "RGMII2_RD2";
enet_cpsw1.RGMII1.RD3.$suggestSolution             = "RGMII2_RD3";
enet_cpsw1.RGMII1.RX_CTL.$suggestSolution          = "RGMII2_RX_CTL";
enet_cpsw1.RGMII1.RXC.$suggestSolution             = "RGMII2_RXC";
enet_cpsw1.RGMII1.TD0.$suggestSolution             = "RGMII2_TD0";
enet_cpsw1.RGMII1.TD1.$suggestSolution             = "RGMII2_TD1";
enet_cpsw1.RGMII1.TD2.$suggestSolution             = "RGMII2_TD2";
enet_cpsw1.RGMII1.TD3.$suggestSolution             = "RGMII2_TD3";
enet_cpsw1.RGMII1.TX_CTL.$suggestSolution          = "RGMII2_TX_CTL";
enet_cpsw1.RGMII1.TXC.$suggestSolution             = "RGMII2_TXC";
enet_cpsw1.RGMII2.$suggestSolution                 = "RGMII1";
enet_cpsw1.RGMII2.RD0.$suggestSolution             = "RGMII1_RD0";
enet_cpsw1.RGMII2.RD1.$suggestSolution             = "RGMII1_RD1";
enet_cpsw1.RGMII2.RD2.$suggestSolution             = "RGMII1_RD2";
enet_cpsw1.RGMII2.RD3.$suggestSolution             = "RGMII1_RD3";
enet_cpsw1.RGMII2.RX_CTL.$suggestSolution          = "RGMII1_RX_CTL";
enet_cpsw1.RGMII2.RXC.$suggestSolution             = "RGMII1_RXC";
enet_cpsw1.RGMII2.TD0.$suggestSolution             = "RGMII1_TD0";
enet_cpsw1.RGMII2.TD1.$suggestSolution             = "RGMII1_TD1";
enet_cpsw1.RGMII2.TD2.$suggestSolution             = "RGMII1_TD2";
enet_cpsw1.RGMII2.TD3.$suggestSolution             = "RGMII1_TD3";
enet_cpsw1.RGMII2.TX_CTL.$suggestSolution          = "RGMII1_TX_CTL";
enet_cpsw1.RGMII2.TXC.$suggestSolution             = "RGMII1_TXC";
