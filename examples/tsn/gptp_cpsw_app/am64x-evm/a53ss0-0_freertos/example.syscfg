/**
 * @cliArgs --device "AM64x" --part "Default" --package "ALV" --context "a53ss0-0" --product "MCU_PLUS_SDK@07.03.01"
 * @versions {"tool":"1.21.2+3837"}
 */

/**
 * Import the modules used in this configuration.
 */
const eeprom     = scripting.addModule("/board/eeprom/eeprom", {}, false);
const eeprom1    = eeprom.addInstance();
const i2c        = scripting.addModule("/drivers/i2c/i2c", {}, false);
const i2c1       = i2c.addInstance();
const i2c2       = i2c.addInstance();
const debug_log  = scripting.addModule("/kernel/dpl/debug_log");
const dpl_cfg    = scripting.addModule("/kernel/dpl/dpl_cfg");
const mmu_armv8  = scripting.addModule("/kernel/dpl/mmu_armv8", {}, false);
const mmu_armv81 = mmu_armv8.addInstance();
const mmu_armv82 = mmu_armv8.addInstance();
const mmu_armv83 = mmu_armv8.addInstance();
const enet_cpsw  = scripting.addModule("/networking/enet_cpsw/enet_cpsw", {}, false);
const enet_cpsw1 = enet_cpsw.addInstance();

/**
 * Write custom configuration values to the imported modules.
 */
eeprom1.$name = "CONFIG_EEPROM0";

i2c1.$name               = "CONFIG_I2C0";
eeprom1.peripheralDriver = i2c1;
i2c1.I2C.$assign         = "I2C0";
i2c1.I2C.SCL.$assign     = "I2C0_SCL";
i2c1.I2C.SDA.$assign     = "I2C0_SDA";
i2c1.I2C_child.$name     = "drivers_i2c_v0_i2c_v0_template1";

i2c2.$name           = "CONFIG_I2C1";
i2c2.I2C.$assign     = "I2C1";
i2c2.I2C.SCL.$assign = "I2C1_SCL";
i2c2.I2C.SDA.$assign = "I2C1_SDA";
i2c2.I2C_child.$name = "drivers_i2c_v0_i2c_v0_template2";

debug_log.enableUartLog        = true;
debug_log.enableCssLog         = false;
debug_log.uartLog.$name        = "CONFIG_UART_CONSOLE";
debug_log.uartLog.UART.$assign = "USART0";

const uart_v0_template  = scripting.addModule("/drivers/uart/v0/uart_v0_template", {}, false);
const uart_v0_template1 = uart_v0_template.addInstance({}, false);
uart_v0_template1.$name = "drivers_uart_v0_uart_v0_template0";
debug_log.uartLog.child = uart_v0_template1;

mmu_armv81.$name = "CONFIG_MMU_REGION0";
mmu_armv81.size  = 0x80000000;

mmu_armv82.$name     = "CONFIG_MMU_REGION1";
mmu_armv82.vAddr     = 0x70000000;
mmu_armv82.pAddr     = 0x70000000;
mmu_armv82.size      = 0x200000;
mmu_armv82.attribute = "MAIR7";

mmu_armv83.$name     = "CONFIG_MMU_REGION2";
mmu_armv83.vAddr     = 0x80000000;
mmu_armv83.pAddr     = 0x80000000;
mmu_armv83.size      = 0x80000000;
mmu_armv83.attribute = "MAIR7";

enet_cpsw1.$name                          = "CONFIG_ENET_CPSW0";
enet_cpsw1.mdioMode                       = "MDIO_MODE_MANUAL";
enet_cpsw1.enableTsOut                    = true;
enet_cpsw1.MDIO.$assign                   = "MDIO0";
enet_cpsw1.MDIO.MDC.$assign               = "PRG0_PRU1_GPO19";
enet_cpsw1.MDIO.MDIO.$assign              = "PRG0_PRU1_GPO18";
enet_cpsw1.RGMII.$assign                  = "CPSW";
enet_cpsw1.txDmaChannel.create(2);
enet_cpsw1.txDmaChannel[0].$name          = "ENET_DMA_TX_CH0";
enet_cpsw1.txDmaChannel[0].useGlobalEvt   = true;
enet_cpsw1.txDmaChannel[0].PacketsCount   = 8;
enet_cpsw1.txDmaChannel[1].$name          = "ENET_DMA_TX_CH_PTP";
enet_cpsw1.txDmaChannel[1].useGlobalEvt   = true;
enet_cpsw1.txDmaChannel[1].PacketsCount   = 8;
enet_cpsw1.rxDmaChannel.create(2);
enet_cpsw1.rxDmaChannel[0].$name          = "ENET_DMA_RX_CH0";
enet_cpsw1.rxDmaChannel[0].useGlobalEvt   = true;
enet_cpsw1.rxDmaChannel[0].sizeThreshEn   = 0x0;
enet_cpsw1.rxDmaChannel[0].PacketsCount   = 16;
enet_cpsw1.rxDmaChannel[1].$name          = "ENET_DMA_RX_CH_PTP";
enet_cpsw1.rxDmaChannel[1].useDefaultFlow = false;
enet_cpsw1.rxDmaChannel[1].macAddrCount   = 0;
enet_cpsw1.rxDmaChannel[1].PacketsCount   = 16;
enet_cpsw1.CPSW_CPTS.TS_SYNC.$assign      = "PRG0_PRU0_GPO17";

const ethphy_cpsw_icssg  = scripting.addModule("/board/ethphy_cpsw_icssg/ethphy_cpsw_icssg", {}, false);
const ethphy_cpsw_icssg1 = ethphy_cpsw_icssg.addInstance({}, false);
ethphy_cpsw_icssg1.$name = "CONFIG_ENET_ETHPHY0";
enet_cpsw1.ethphy1       = ethphy_cpsw_icssg1;

const ethphy_cpsw_icssg2 = ethphy_cpsw_icssg.addInstance({}, false);
ethphy_cpsw_icssg2.$name = "CONFIG_ENET_ETHPHY1";
enet_cpsw1.ethphy2       = ethphy_cpsw_icssg2;

const udma         = scripting.addModule("/drivers/udma/udma", {}, false);
const udma1        = udma.addInstance({}, false);
enet_cpsw1.udmaDrv = udma1;

/**
 * Pinmux solution for unlocked pins/peripherals. This ensures that minor changes to the automatic solver in a future
 * version of the tool will not impact the pinmux you originally saw.  These lines can be completely deleted in order to
 * re-solve from scratch.
 */
debug_log.uartLog.UART.RXD.$suggestSolution     = "UART0_RXD";
debug_log.uartLog.UART.TXD.$suggestSolution     = "UART0_TXD";
enet_cpsw1.RGMII.RGMII1_RD0.$suggestSolution    = "PRG0_PRU1_GPO7";
enet_cpsw1.RGMII.RGMII1_RD1.$suggestSolution    = "PRG0_PRU1_GPO9";
enet_cpsw1.RGMII.RGMII1_RD2.$suggestSolution    = "PRG0_PRU1_GPO10";
enet_cpsw1.RGMII.RGMII1_RD3.$suggestSolution    = "PRG0_PRU1_GPO17";
enet_cpsw1.RGMII.RGMII1_RX_CTL.$suggestSolution = "PRG0_PRU0_GPO9";
enet_cpsw1.RGMII.RGMII1_RXC.$suggestSolution    = "PRG0_PRU0_GPO10";
enet_cpsw1.RGMII.RGMII1_TD0.$suggestSolution    = "PRG1_PRU1_GPO7";
enet_cpsw1.RGMII.RGMII1_TD1.$suggestSolution    = "PRG1_PRU1_GPO9";
enet_cpsw1.RGMII.RGMII1_TD2.$suggestSolution    = "PRG1_PRU1_GPO10";
enet_cpsw1.RGMII.RGMII1_TD3.$suggestSolution    = "PRG1_PRU1_GPO17";
enet_cpsw1.RGMII.RGMII1_TX_CTL.$suggestSolution = "PRG1_PRU0_GPO9";
enet_cpsw1.RGMII.RGMII1_TXC.$suggestSolution    = "PRG1_PRU0_GPO10";
enet_cpsw1.RGMII.RGMII2_RD0.$suggestSolution    = "PRG1_PRU1_GPO0";
enet_cpsw1.RGMII.RGMII2_RD1.$suggestSolution    = "PRG1_PRU1_GPO1";
enet_cpsw1.RGMII.RGMII2_RD2.$suggestSolution    = "PRG1_PRU1_GPO2";
enet_cpsw1.RGMII.RGMII2_RD3.$suggestSolution    = "PRG1_PRU1_GPO3";
enet_cpsw1.RGMII.RGMII2_RX_CTL.$suggestSolution = "PRG1_PRU1_GPO4";
enet_cpsw1.RGMII.RGMII2_RXC.$suggestSolution    = "PRG1_PRU1_GPO6";
enet_cpsw1.RGMII.RGMII2_TD0.$suggestSolution    = "PRG1_PRU1_GPO11";
enet_cpsw1.RGMII.RGMII2_TD1.$suggestSolution    = "PRG1_PRU1_GPO12";
enet_cpsw1.RGMII.RGMII2_TD2.$suggestSolution    = "PRG1_PRU1_GPO13";
enet_cpsw1.RGMII.RGMII2_TD3.$suggestSolution    = "PRG1_PRU1_GPO14";
enet_cpsw1.RGMII.RGMII2_TX_CTL.$suggestSolution = "PRG1_PRU1_GPO15";
enet_cpsw1.RGMII.RGMII2_TXC.$suggestSolution    = "PRG1_PRU1_GPO16";
enet_cpsw1.CPSW_CPTS.$suggestSolution           = "CP_GEMAC_CPTS0";
